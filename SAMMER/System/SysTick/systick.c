/*
***********************************************************************
* 			YanJunFly V1.0 - Copyright (c) 2017
* All rights reserved.More information please browse www.yanjun.tech
* 燕骏智控-最给力的开源飞控社区，这里有最优秀的学习教程。YJ飞行器社区 -- 永不止步！
* 
* 其他声明：对代码中产生的bug，本人不承担任何直接或间接的损害赔偿
*						若使用本代码即视为默认本条款。若发现bug，请将详细信息
*						发送下面链接至评论区，谢谢！
*						http://www.yanjun.tech/forum.php?gid=87
*
* 文件名称：systick.c,systick.h
* 文件摘要：无
* 注意事项：无
*						
* 当前版本：v1.0
* 当前作者：石雄涛
* 完成日期：2017-3-16 17:45:05
* 改动说明：创建文件
*
* 取代版本：无
* 原 作 者：石雄涛
* 完成日期：2017-3-16 17:45:05
***********************************************************************
*/

/**
*包括头文件
*
*/

#include "systick.h"

/**
*这个值必须声明称 volatile 类型 否则后面的延时就会死掉
*
*/

volatile uint32_t vulSystickInMs = 0;

/*
***********************************************************************
*函数名称：void vSystickInit(uint32_t ulFrequency)
*
*函数功能：滴答定时器初始化
*
*使用说明：无
*入口参数：ulFrequency：滴答定时器回调的周期
*返 回 值：无
*
*当前作者：石雄涛
*创建日期：2017-3-16 17:45:12
*函数版本：v1.0 
*修改原因：无
*
*取代版本：无
*原 作 者：石雄涛
*完成日期：2017-3-16 17:45:12
***********************************************************************
*/

void vSystickInit(uint32_t ulFrequency)
{		
	/* 配置Systick的时钟 AHB的时钟是72M */
	SysTick_CLKSourceConfig(SysTick_CLKSource_HCLK);
	/* 配置自动重装载值 */
	SysTick->LOAD = ((uint32_t)72000000/ulFrequency);
	/* 重置计数器 */
	SysTick->VAL = 0;
	/* 配置Systick 
		1.使能时钟
		2.使能中断
		3.使能Systick */
	SysTick->CTRL = 0x7;
	/* STM32的高字节存储在搞地址上，也就是小端模式 */
	/* 经过数据手册查询对应的是 11 */
	/* 在前面的分组中 我设置成0 全部都是抢占优先级分组 */
	/* STM32应用高四位作为中断优先级 最多有 16 个优先级 也就是最多是 0XF0 这个异常不重要，所以设置成最低的优先级 */
	SCB->SHP[11] = 0XF0;
}

/*
***********************************************************************
*函数名称：uint32_t ulGetSystickNowInMs(void) 
*
*函数功能：返回现在系统的时间，MS单位
*
*使用说明：最多能保证49天内不溢出
*入口参数：无
*返 回 值：现在系统的时间，ms单位
*
*当前作者：石雄涛
*创建日期：2017-3-16 17:45:12
*函数版本：v1.0 
*修改原因：无
*
*取代版本：无
*原 作 者：石雄涛
*完成日期：2017-3-16 17:45:12
***********************************************************************
*/

uint32_t ulGetSystickNowInMs(void) 
{
	return vulSystickInMs; 
}

/*
***********************************************************************
*函数名称：void vDelaySystickInMs(uint32_t ulMs)
*
*函数功能：以ms为单位进行阻塞延时
					里面会自动进行溢出判断，所以永远不会错误
*
*使用说明：调用函数，会阻塞进程
*入口参数：ulMs：要延时的MS时间
*返 回 值：无
*
*当前作者：石雄涛
*创建日期：2017-3-16 17:45:12
*函数版本：v1.0 
*修改原因：无
*
*取代版本：无
*原 作 者：石雄涛
*完成日期：2017-3-16 17:45:12
***********************************************************************
*/

void vDelaySystickInMs(uint32_t ulMs)
{
	uint32_t sysTickStart = vulSystickInMs;
	
	while(1)
	{
		/* 溢出安全判断 */
		if(vulSystickInMs >= sysTickStart)
		{
			while((vulSystickInMs - sysTickStart) < ulMs)
			{}
			/* 时间到返回 */
			return ;
		}else
		{
			/* 计数值溢出，计算方法改变 */
			while(((((uint32_t)0xffffffff) - sysTickStart) + vulSystickInMs) < ulMs)
			{
				
			}
			/* 时间到返回 */
			return ;
		}
	}
}

/*
***********************************************************************
*函数名称：void SysTick_Handler(void)
*
*函数功能：系统的systick中断
*
*使用说明：硬件自动调用
*入口参数：无
*返 回 值：无
*
*当前作者：石雄涛
*创建日期：2017-3-16 17:45:12
*函数版本：v1.0 
*修改原因：无
*
*取代版本：无
*原 作 者：石雄涛
*完成日期：2017-3-16 17:45:12
***********************************************************************
*/

void SysTick_Handler(void)
{
	vulSystickInMs++;
}

/* end of file cppyright reserve by team of yanjun ,More information please browse www.yanjun.tech */
